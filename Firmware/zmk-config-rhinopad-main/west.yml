## Firmware/zmk-config-rhinopad-main/west.yml
```yaml
manifest:
  self:
    # Path of this repo *inside* the workspace
    path: Firmware/zmk-config-rhinopad-main

  remotes:
    - name: zmkfirmware
      url-base: https://github.com

  projects:
    - name: zmk
      remote: zmkfirmware
      revision: main
      import: app/west.yml
```
